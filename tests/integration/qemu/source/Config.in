## tests/integration/qemu/source/Config.in
```kconfig
# Copyright 2026 Xiaomi Corporation
#
# SPDX-License-Identifier: Apache-2.0

menu "BSWorld guest packages"

source "$BR2_EXTERNAL_BSWORLD_PATH/package/bsworld-nimble-linux/Config.in"

endmenu
```

## tests/integration/qemu/source/configs/bsworld_qemu_linux_defconfig
```kconfig
# Copyright 2026 Xiaomi Corporation
#
# SPDX-License-Identifier: Apache-2.0

BR2_aarch64=y
# Use the pinned Buildroot release's prebuilt AArch64 glibc toolchain.
# This profile includes C++ and threads for the NimBLE example.
BR2_TOOLCHAIN_EXTERNAL=y
BR2_TOOLCHAIN_EXTERNAL_BOOTLIN=y
BR2_TOOLCHAIN_EXTERNAL_BOOTLIN_AARCH64_GLIBC_STABLE=y
BR2_TOOLCHAIN_EXTERNAL_DOWNLOAD=y
BR2_GLOBAL_PATCH_DIR="board/qemu/patches"
BR2_DOWNLOAD_FORCE_CHECK_HASHES=y
BR2_LINUX_KERNEL=y
BR2_LINUX_KERNEL_CUSTOM_VERSION=y
BR2_LINUX_KERNEL_CUSTOM_VERSION_VALUE="6.18.7"
BR2_LINUX_KERNEL_USE_CUSTOM_CONFIG=y
BR2_LINUX_KERNEL_CUSTOM_CONFIG_FILE="board/qemu/aarch64-virt/linux.config"
BR2_LINUX_KERNEL_CONFIG_FRAGMENT_FILES="$(BR2_EXTERNAL_BSWORLD_PATH)/board/linux/linux.fragment"
BR2_LINUX_KERNEL_NEEDS_HOST_OPENSSL=y
BR2_PACKAGE_BSWORLD_NIMBLE_LINUX=y
BR2_PACKAGE_BLUEZ5_UTILS=y
BR2_PACKAGE_BLUEZ5_UTILS_CLIENT=y
BR2_PACKAGE_BLUEZ5_UTILS_TOOLS=y
BR2_PACKAGE_BLUEZ5_UTILS_DEPRECATED=y
# BR2_PACKAGE_BLUEZ5_UTILS_PLUGINS_NETWORK is not set
BR2_TARGET_ROOTFS_CPIO=y
# BR2_TARGET_ROOTFS_TAR is not set
```

## tests/integration/qemu/source/package/bsworld-nimble-linux/Config.in
```kconfig
# Copyright 2026 Xiaomi Corporation
#
# SPDX-License-Identifier: Apache-2.0

config BR2_PACKAGE_BSWORLD_NIMBLE_LINUX
	bool "Apache NimBLE Linux example"
	depends on BR2_INSTALL_LIBSTDCPP
	depends on BR2_TOOLCHAIN_HAS_THREADS
	select BR2_PACKAGE_MBEDTLS
	help
	  Build the upstream Apache NimBLE Linux example as a Host-only
	  Application. It opens a Linux HCI device through HCI User Channel.

comment "Apache NimBLE Linux example needs a toolchain with C++ and threads"
	depends on !BR2_INSTALL_LIBSTDCPP || !BR2_TOOLCHAIN_HAS_THREADS
```

## tests/integration/qemu/source/package/bsworld-trouble-linux/Config.in
```kconfig
# Copyright 2026 Xiaomi Corporation
#
# SPDX-License-Identifier: Apache-2.0

config BR2_PACKAGE_BSWORLD_TROUBLE_LINUX
	bool "TrouBLE Linux example"
	depends on BR2_PACKAGE_HOST_RUSTC_TARGET_ARCH_SUPPORTS
	select BR2_PACKAGE_HOST_RUSTC
	help
	  Build the upstream TrouBLE Battery Service peripheral example for
	  Linux. It opens a Linux HCI device through HCI User Channel.

comment "TrouBLE Linux example needs a Rust-supported target architecture"
	depends on !BR2_PACKAGE_HOST_RUSTC_TARGET_ARCH_SUPPORTS
```
