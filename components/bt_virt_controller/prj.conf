## CMakeLists.txt
```
# Copyright 2026 Xiaomi Corporation
#
# SPDX-License-Identifier: Apache-2.0

cmake_minimum_required(VERSION 3.20.0)
find_package(Zephyr REQUIRED HINTS $ENV{ZEPHYR_BASE})
project(hci_virt)

target_sources(app PRIVATE src/main.c)

target_compile_options(native_simulator INTERFACE
  -DHCI_VIRT_IRQ=${CONFIG_HCI_VIRT_IRQ}
  "-I${ZEPHYR_BASE}/boards/native/nrf_bsim/common"
)

# Bottom layer runs in host/runner context and exposes HCI over Unix sockets.
target_sources(native_simulator INTERFACE src/hci_virt_bottom_socket.c)
```

## Kconfig
```
# Copyright 2026 Xiaomi Corporation
#
# SPDX-License-Identifier: Apache-2.0

mainmenu "Bluetooth HCI Unix Socket sample"

source "Kconfig.zephyr"

config HCI_VIRT_IRQ
	int "HCI host transport IRQ"
	default 30
	help
	  Simulated IRQ used to wake the Zephyr-side HCI receive thread.
	  For nRF52 bsim this defaults to IRQ 30, which is reserved in the
	  SoC IRQ table but valid in the bsim interrupt controller. Do not use
	  SWI5_EGU5_IRQn/25 here because MPSL uses it as CONFIG_MPSL_LOW_PRIO_IRQN.

config HCI_VIRT_IRQ_PRIORITY
	int "HCI host transport IRQ priority"
	default 2
	help
	  Priority for the simulated interrupt used to wake the Zephyr-side
	  HCI receive thread when host transport input is available.
```

## prj.conf
```kconfig
# Copyright 2026 Xiaomi Corporation
#
# SPDX-License-Identifier: Apache-2.0

CONFIG_BT=y
CONFIG_BT_HCI_RAW=y
CONFIG_BT_MAX_CONN=16

# Enable every LE Controller feature the software Link Layer supports on
# nrf52_bsim, at its largest size. BT_HCI_RAW already defaults encryption,
# privacy, 2M/Coded PHY, CSA#2, connection parameter request, LE Ping,
# extended reject, Peripheral feature exchange and minimum used channels on;
# they are listed so a Zephyr upgrade cannot silently drop them.
CONFIG_BT_CTLR_LE_ENC=y
CONFIG_BT_CTLR_PRIVACY=y
CONFIG_BT_CTLR_FILTER_ACCEPT_LIST=y
CONFIG_BT_CTLR_EXT_SCAN_FP=y
CONFIG_BT_CTLR_PHY_2M=y
CONFIG_BT_CTLR_PHY_CODED=y
CONFIG_BT_CTLR_CHAN_SEL_2=y
CONFIG_BT_CTLR_CONN_PARAM_REQ=y
CONFIG_BT_CTLR_LE_PING=y
CONFIG_BT_CTLR_EXT_REJ_IND=y
CONFIG_BT_CTLR_PER_INIT_FEAT_XCHG=y
CONFIG_BT_CTLR_MIN_USED_CHAN=y
CONFIG_BT_CTLR_CONN_RSSI=y
CONFIG_BT_CTLR_SCAN_REQ_NOTIFY=y
CONFIG_BT_SCA_UPDATE=y
CONFIG_BT_CTLR_SCA_UPDATE=y

# Data Length Extension up to the 251-octet LL maximum.
CONFIG_BT_DATA_LEN_UPDATE=y
CONFIG_BT_CTLR_DATA_LENGTH_MAX=251

CONFIG_BT_EXT_ADV=y
CONFIG_BT_PER_ADV=y
CONFIG_BT_PER_ADV_SYNC=y

CONFIG_BT_CTLR_ADV_EXT=y
CONFIG_BT_CTLR_ADV_SET=8
CONFIG_BT_CTLR_ADV_AUX_SET=8
CONFIG_BT_CTLR_ADV_DATA_LEN_MAX=191
CONFIG_BT_CTLR_SCAN_DATA_LEN_MAX=1650
CONFIG_BT_CTLR_DUP_FILTER_ADV_SET_MAX=8
CONFIG_BT_CTLR_ADV_PERIODIC=y
CONFIG_BT_CTLR_ADV_SYNC_SET=4
CONFIG_BT_CTLR_SYNC_PERIODIC=y
CONFIG_BT_CTLR_SYNC_TRANSFER_RECEIVER=y
CONFIG_BT_CTLR_SYNC_TRANSFER_SENDER=y
CONFIG_BT_CTLR_SYNC_PERIODIC_ADV_LIST_SIZE=8

CONFIG_BT_BUF_EVT_RX_COUNT=16
CONFIG_BT_BUF_EVT_RX_SIZE=255
CONFIG_BT_BUF_ACL_RX_SIZE=251
CONFIG_BT_BUF_ACL_TX_SIZE=251
CONFIG_BT_BUF_CMD_TX_SIZE=255

CONFIG_CONSOLE=n
CONFIG_UART_CONSOLE=n
CONFIG_LOG=y
CONFIG_LOG_MODE_IMMEDIATE=y
CONFIG_BT_LOG_LEVEL_INF=y
CONFIG_ASSERT=y
CONFIG_SPEED_OPTIMIZATIONS=y
```

## src/main.c
```c
/*
 * Copyright 2026 Xiaomi Corporation
 *
 * HCI Unix socket - Expose Zephyr BT Controller without a UART hardware model.
 * Designed for nrf52_bsim: bypasses UART timing simulation entirely.
 *
 * SPDX-License-Identifier: Apache-2.0
 */

#include <errno.h>
#include <stddef.h>
#include <string.h>

#include <soc.h>
#include <zephyr/irq.h>
#include <zephyr/kernel.h>
#include <zephyr/sys/util.h>
#include <zephyr/sys/byteorder.h>
#include <zephyr/net_buf.h>
#include <zephyr/bluetooth/addr.h>
#include <zephyr/bluetooth/bluetooth.h>
#include <zephyr/bluetooth/controller.h>
#include <zephyr/bluetooth/hci.h>
#include <zephyr/bluetooth/buf.h>
#include <zephyr/bluetooth/hci_raw.h>
#include "hci_virt_bottom.h"

#define H4_CMD 0x01
#define H4_ACL 0x02
#define H4_SCO 0x03
#define H4_EVT 0x04
#define H4_ISO 0x05
#define HCI_SNOOP_MAX_FRAME 512

static K_THREAD_STACK_DEFINE(tx_thread_stack, CONFIG_BT_HCI_TX_STACK_SIZE);
static K_THREAD_STACK_DEFINE(rx_fwd_thread_stack, CONFIG_BT_HCI_TX_STACK_SIZE);
static K_THREAD_STACK_DEFINE(rx_thread_stack, CONFIG_BT_HCI_TX_STACK_SIZE);
static struct k_thread tx_thread_data;
static struct k_thread rx_fwd_thread_data;
static struct k_thread rx_thread_data;
static K_FIFO_DEFINE(tx_queue);  /* Host socket -> bt_send */
static K_FIFO_DEFINE(rx_queue);  /* bt_enable_raw -> host socket */
static K_SEM_DEFINE(rx_ready_sem, 0, 1);

static bool valid_type(uint8_t type)
{
	return (type == H4_CMD) || (type == H4_ACL) || (type == H4_ISO);
}

static int parse_public_addr(const char *str, bt_addr_t *addr)
{
	if (strlen(str) != BT_ADDR_STR_LEN - 1) {
		return -EINVAL;
	}

	for (size_t i = 2; i < BT_ADDR_STR_LEN - 1; i += 3) {
		if (str[i] != ':') {
			return -EINVAL;
		}
	}

	for (size_t i = 0; i < ARRAY_SIZE(addr->val); i++) {
		size_t reverse_i = ARRAY_SIZE(addr->val) - 1 - i;

		if (!hex2bin(&str[i * 3], 2, &addr->val[reverse_i], 1)) {
			return -EINVAL;
		}
	}

	return bt_addr_eq(addr, BT_ADDR_ANY) ? -EINVAL : 0;
}

static int set_public_addr_from_arg(void)
{
	const char *addr_arg = hci_virt_bd_addr();
	bt_addr_t bdaddr;
	int err;

	if (!addr_arg) {
		return 0;
	}

	err = parse_public_addr(addr_arg, &bdaddr);
	if (err) {
		return err;
	}

	bt_ctlr_set_public_addr(bdaddr.val);

	return 0;
}

static uint32_t get_len(const uint8_t *hdr_buf, uint8_t type)
{
	switch (type) {
	case H4_CMD:
		return ((const struct bt_hci_cmd_hdr *)hdr_buf)->param_len;
	case H4_ISO:
		return bt_iso_hdr_len(
			sys_le16_to_cpu(((const struct bt_hci_iso_hdr *)hdr_buf)->len));
	case H4_ACL:
		return sys_le16_to_cpu(((const struct bt_hci_acl_hdr *)hdr_buf)->len);
	default:
		return 0;
	}
}

static int hdr_len(uint8_t type)
{
	switch (type) {
	case H4_CMD:
		return sizeof(struct bt_hci_cmd_hdr);
	case H4_ISO:
		return sizeof(struct bt_hci_iso_hdr);
	case H4_ACL:
		return sizeof(struct bt_hci_acl_hdr);
	default:
		return 0;
	}
}

static void capture_host_frame(uint8_t type, const struct net_buf *buf)
{
	__ASSERT_NO_MSG(buf->len > 0 && buf->data[0] == type);
	hci_virt_btsnoop_capture(buf->data, buf->len, true);
}

static void hci_virt_isr(const void *arg)
{
	ARG_UNUSED(arg);

	k_sem_give(&rx_ready_sem);
}

/* TX thread: Controller -> host socket (rx_queue filled by bt_enable_raw)
 * bt_enable_raw prepends the H4 type byte into buf->data[0], so
 * buf->data already contains a complete H4 frame. */
static void tx_thread(void *p1, void *p2, void *p3)
{
	while (1) {
		struct net_buf *buf = k_fifo_get(&rx_queue, K_FOREVER);

		hci_virt_btsnoop_capture(buf->data, buf->len, false);
		__ASSERT_NO_MSG(hci_virt_write(buf->data, buf->len) > 0);
		net_buf_unref(buf);

		k_yield();
	}
}

/* RX fwd thread: tx_queue -> bt_send (host socket -> Controller) */
static void rx_fwd_thread(void *p1, void *p2, void *p3)
{
	while (1) {
		struct net_buf *buf = k_fifo_get(&tx_queue, K_FOREVER);
		int err = bt_send(buf);

		__ASSERT_NO_MSG(err == 0);
	}
}

/* Main thread: host socket -> tx_queue (non-blocking state machine) */
static void rx_thread(void *p1, void *p2, void *p3)
{
	enum { ST_TYPE, ST_HDR, ST_PAYLOAD } state = ST_TYPE;
	uint8_t type = 0;
	uint8_t hdr_buf[MAX(sizeof(struct bt_hci_cmd_hdr),
			    MAX(sizeof(struct bt_hci_acl_hdr),
				sizeof(struct bt_hci_iso_hdr)))];
	int hlen = 0, hread = 0;
	int payload_len = 0, payload_read = 0;
	struct net_buf *buf = NULL;

	while (1) {
		k_sem_take(&rx_ready_sem, K_FOREVER);

		if (!hci_virt_poll()) {
			continue;
		}

		do {
			if (state == ST_TYPE) {
				long n = hci_virt_read(&type, 1);

				__ASSERT_NO_MSG(n == 1);

				if (!valid_type(type)) {
					continue;
				}
				hlen = hdr_len(type);
				hread = 0;
				state = ST_HDR;

			} else if (state == ST_HDR) {
				long n = hci_virt_read(hdr_buf + hread, hlen - hread);

				__ASSERT_NO_MSG(n > 0);

				hread += (int)n;
				if (hread < hlen) {
					continue;
				}

				buf = bt_buf_get_tx(bt_buf_type_from_h4(type, BT_BUF_OUT),
						    K_FOREVER, NULL, 0);
				if (!buf) {
					state = ST_TYPE;
					continue;
				}
				net_buf_add_mem(buf, hdr_buf, hlen);

				payload_len = (int)get_len(hdr_buf, type);
				payload_read = 0;

				if (payload_len == 0) {
					capture_host_frame(type, buf);
					k_fifo_put(&tx_queue, buf);
					buf = NULL;
					state = ST_TYPE;
				} else if (payload_len > (int)net_buf_tailroom(buf)) {
					net_buf_unref(buf);
					buf = NULL;
					state = ST_TYPE;
				} else {
					state = ST_PAYLOAD;
				}

			} else { /* ST_PAYLOAD */
				long n = hci_virt_read(net_buf_tail(buf) + payload_read,
						      payload_len - payload_read);

				__ASSERT_NO_MSG(n > 0);

				payload_read += (int)n;
				if (payload_read < payload_len) {
					continue;
				}
				buf->len += payload_len;
				capture_host_frame(type, buf);
				k_fifo_put(&tx_queue, buf);
				buf = NULL;
				state = ST_TYPE;
			}
		} while (hci_virt_poll());
	}
}

int main(void)
{
	int err;

	IRQ_CONNECT(HCI_VIRT_IRQ, CONFIG_HCI_VIRT_IRQ_PRIORITY,
		    hci_virt_isr, NULL, 0);
	irq_enable(HCI_VIRT_IRQ);

	err = set_public_addr_from_arg();
	if (err) {
		hci_virt_trace("failed to set controller public address: %d\n", err);
		return err;
	}

	hci_virt_open();

	err = bt_enable_raw(&rx_queue);
	if (err) {
		hci_virt_trace("failed to enable Bluetooth RAW mode: %d\n", err);
		return err;
	}

	k_thread_create(&tx_thread_data, tx_thread_stack,
			K_THREAD_STACK_SIZEOF(tx_thread_stack),
			tx_thread, NULL, NULL, NULL,
			K_PRIO_COOP(7), 0, K_NO_WAIT);
	k_thread_name_set(&tx_thread_data, "HCI socket TX");

	k_thread_create(&rx_fwd_thread_data, rx_fwd_thread_stack,
			K_THREAD_STACK_SIZEOF(rx_fwd_thread_stack),
			rx_fwd_thread, NULL, NULL, NULL,
			K_PRIO_COOP(7), 0, K_NO_WAIT);
	k_thread_name_set(&rx_fwd_thread_data, "HCI socket RX FWD");

	k_thread_create(&rx_thread_data, rx_thread_stack,
			K_THREAD_STACK_SIZEOF(rx_thread_stack),
			rx_thread, NULL, NULL, NULL,
			K_PRIO_COOP(7), 0, K_NO_WAIT);
	k_thread_name_set(&rx_thread_data, "HCI socket RX");

	while (1) {
		k_sleep(K_FOREVER);
	}

	return 0;
}
```

## src/hci_virt_bottom.h
```c
/*
 * Copyright 2026 Xiaomi Corporation
 *
 * SPDX-License-Identifier: Apache-2.0
 */

#ifndef HCI_VIRT_BOTTOM_H
#define HCI_VIRT_BOTTOM_H

#include <stdbool.h>
#include <stdint.h>

#ifndef HCI_VIRT_IRQ
#ifdef CONFIG_HCI_VIRT_IRQ
#define HCI_VIRT_IRQ CONFIG_HCI_VIRT_IRQ
#else
#define HCI_VIRT_IRQ 30
#endif
#endif

int  hci_virt_open(void);
const char *hci_virt_bd_addr(void);
void hci_virt_trace(const char *fmt, ...);
int  hci_virt_poll(void);
long hci_virt_read(void *buf, unsigned long len);
long hci_virt_write(const void *buf, unsigned long len);
void hci_virt_btsnoop_capture(const void *buf, unsigned long len, bool tx);

#endif /* HCI_VIRT_BOTTOM_H */
```

## src/hci_virt_bottom_socket.c
```c
/*
 * Copyright 2026 Xiaomi Corporation
 *
 * Host/bottom side: exposes HCI over a Unix domain socket.
 * Built in native_simulator runner context.
 * Use -hci-socket=<path> on the command line to specify the socket path,
 * or defaults to /tmp/hci0.sock.
 * Use -btsnoop-file=<path> to write BTSnoop capture directly to a file.
 * Use -bd-addr=<AA:BB:CC:DD:EE:FF> to set the controller public address.
 * Use -hci-poll-interval=<microseconds> to override the default 1 ms HCI poll
 * interval and PHY maximum resynchronization offset.
 *
 * The socket is created as a SOCK_STREAM server; it accepts one client at a
 * time.  If the client disconnects, it waits for a new connection.
 *
 * SPDX-License-Identifier: Apache-2.0
 */

#include <stdbool.h>
#include <stdint.h>
#include <string.h>
#include <errno.h>
#include <fcntl.h>
#include <unistd.h>
#include <stdio.h>
#include <poll.h>
#include <stdarg.h>
#include <sys/socket.h>
#include <sys/un.h>
#include "irq_ctrl.h"
#include "nsi_hw_scheduler.h"
#include "nsi_hws_models_if.h"
#include <nsi_tracing.h>
#include <nsi_tasks.h>
#include "bs_cmd_line.h"
#include "bs_dynargs.h"
#include "phy_sync_ctrl.h"
#include "hci_virt_bottom.h"

#define DEFAULT_SOCKET_PATH "/tmp/hci0.sock"
#define DEFAULT_HCI_POLL_INTERVAL_US 1000U
#define BTSNOOP_DATALINK_HCI_H4 1002U
#define BTSNOOP_EPOCH_DELTA_US 0x00DCDDB30F2F8000ULL
#define BTSNOOP_FILE_HEADER_LEN 16
#define BTSNOOP_RECORD_HEADER_LEN 24
#define BTSNOOP_MAX_FRAME 2048

static int listen_fd = -1;
static int client_fd = -1;
static int btsnoop_fd = -1;
static char *socket_path_arg;
static char *btsnoop_file_path_arg;
static char *bd_addr_arg;
static uint64_t hci_poll_interval_arg;
static bs_time_t hci_poll_interval_us = DEFAULT_HCI_POLL_INTERVAL_US;
static uint64_t hci_virt_poll_time = NSI_NEVER;
static uint32_t btsnoop_drops;

#if defined(NSI_PRIMARY_MCU_N)
#define HCI_VIRT_SET_IRQ() hw_irq_ctrl_set_irq(NSI_PRIMARY_MCU_N, HCI_VIRT_IRQ)
#else
#define HCI_VIRT_SET_IRQ() hw_irq_ctrl_set_irq(HCI_VIRT_IRQ)
#endif

static void put_be32(uint8_t *dst, uint32_t value)
{
	dst[0] = (uint8_t)(value >> 24);
	dst[1] = (uint8_t)(value >> 16);
	dst[2] = (uint8_t)(value >> 8);
	dst[3] = (uint8_t)value;
}

static void put_be64(uint8_t *dst, uint64_t value)
{
	put_be32(dst, (uint32_t)(value >> 32));
	put_be32(dst + 4, (uint32_t)value);
}

static void set_nonblocking(int fd)
{
	fcntl(fd, F_SETFL, fcntl(fd, F_GETFL) | O_NONBLOCK);
}

static void schedule_poll(bs_time_t delay_us)
{
	hci_virt_poll_time = nsi_hws_get_time() + delay_us;
	nsi_hws_find_next_event();
}

static void hci_virt_poll_event(void)
{
	if (hci_virt_poll()) {
		HCI_VIRT_SET_IRQ();
	}

	schedule_poll(hci_poll_interval_us);
}

/* Run after the priority-900 PHY synchronization event at the same timestamp. */
NSI_HW_EVENT(hci_virt_poll_time, hci_virt_poll_event, 901);

static void configure_hci_poll_interval(char *argv, int offset)
{
	(void)argv;
	(void)offset;

	if (hci_poll_interval_arg == 0 || hci_poll_interval_arg == TIME_NEVER) {
		nsi_print_error_and_exit("hci-poll-interval must be between 1 and %llu microseconds\n",
					 (unsigned long long)(TIME_NEVER - 1));
	}

	hci_poll_interval_us = hci_poll_interval_arg;
}

static void register_socket_args(void)
{
	static bs_args_struct_t opts[] = {
		{
			.option   = "hci-socket",
			.name     = "path",
			.type     = 's',
			.dest     = (void *)&socket_path_arg,
			.descript = "Unix socket path for HCI transport "
				    "(default: " DEFAULT_SOCKET_PATH ")",
		},
		{
			.option   = "btsnoop-file",
			.name     = "path",
			.type     = 's',
			.dest     = (void *)&btsnoop_file_path_arg,
			.descript = "File path for BTSnoop HCI capture "
				    "(disabled by default)",
		},
		{
			.option   = "bd-addr",
			.name     = "addr",
			.type     = 's',
			.dest     = (void *)&bd_addr_arg,
			.descript = "controller public address in AA:BB:CC:DD:EE:FF format",
		},
		{
			.option   = "hci-poll-interval",
			.name     = "microseconds",
			.type     = 'U',
			.dest     = (void *)&hci_poll_interval_arg,
			.call_when_found = configure_hci_poll_interval,
			.descript = "HCI socket poll interval and PHY maximum resynchronization "
				    "offset (default: 1000 microseconds)",
		},
		ARG_TABLE_ENDMARKER,
	};

	bs_add_extra_dynargs(opts);
}

NSI_TASK(register_socket_args, PRE_BOOT_1, 1);

void hci_virt_trace(const char *fmt, ...)
{
	va_list ap;

	va_start(ap, fmt);
	nsi_vprint_trace(fmt, ap);
	va_end(ap);
}

static const char *get_path(void)
{
	return (socket_path_arg && socket_path_arg[0]) ? socket_path_arg
						       : DEFAULT_SOCKET_PATH;
}

const char *hci_virt_bd_addr(void)
{
	return (bd_addr_arg && bd_addr_arg[0]) ? bd_addr_arg : NULL;
}

static void write_btsnoop_all(const uint8_t *buf, unsigned long len)
{
	unsigned long total = 0;

	while (total < len) {
		ssize_t n = write(btsnoop_fd, buf + total, len - total);

		if (n < 0 && errno == EINTR) {
			continue;
		}
		if (n <= 0) {
			nsi_print_error_and_exit("btsnoop_file: write failed: %s\n", strerror(errno));
		}
		total += (unsigned long)n;
	}
}

static void write_btsnoop_file_header(void)
{
	uint8_t header[BTSNOOP_FILE_HEADER_LEN] = {
		'b', 't', 's', 'n', 'o', 'o', 'p', '\0',
	};

	put_be32(&header[8], 1);
	put_be32(&header[12], BTSNOOP_DATALINK_HCI_H4);

	write_btsnoop_all(header, sizeof(header));
}

static void open_btsnoop_file(void)
{
	if (!btsnoop_file_path_arg || !btsnoop_file_path_arg[0]) {
		return;
	}

	/* Unbuffered writes preserve the last record even on SIGKILL teardown. */
	btsnoop_fd = open(btsnoop_file_path_arg, O_WRONLY | O_CREAT | O_TRUNC | O_CLOEXEC, 0644);
	if (btsnoop_fd < 0) {
		nsi_print_error_and_exit("btsnoop_file: open %s: %s\n",
					btsnoop_file_path_arg, strerror(errno));
	}
	write_btsnoop_file_header();
	nsi_print_trace("btsnoop_file: %s\n", btsnoop_file_path_arg);
}

/* Non-blocking single attempt: returns 1 if accepted, 0 if no client yet */
static int try_accept(void)
{
	client_fd = accept(listen_fd, NULL, NULL);
	if (client_fd >= 0) {
		set_nonblocking(client_fd);
		nsi_print_trace("hci_socket: client connected\n");
		return 1;
	}

	if (errno == EAGAIN || errno == EWOULDBLOCK) {
		return 0;
	}

	nsi_print_error_and_exit("hci_socket: accept: %s\n", strerror(errno));

	return 0;
}

/* Bind and listen only; does NOT block waiting for a client. */
int hci_virt_open(void)
{
	const char *path = get_path();
	struct sockaddr_un addr = { .sun_family = AF_UNIX };

	phy_sync_ctrl_set_max_resync_offset(hci_poll_interval_us);
	unlink(path);

	listen_fd = socket(AF_UNIX, SOCK_STREAM | SOCK_CLOEXEC, 0);
	if (listen_fd < 0) {
		nsi_print_error_and_exit("hci_socket: socket: %s\n", strerror(errno));
	}

	strncpy(addr.sun_path, path, sizeof(addr.sun_path) - 1);
	if (bind(listen_fd, (struct sockaddr *)&addr, sizeof(addr)) < 0) {
		nsi_print_error_and_exit("hci_socket: bind %s: %s\n",
					 path, strerror(errno));
	}

	if (listen(listen_fd, 1) < 0) {
		nsi_print_error_and_exit("hci_socket: listen: %s\n", strerror(errno));
	}

	set_nonblocking(listen_fd);
	nsi_print_trace("hci_socket: Unix socket = %s\n", path);
	open_btsnoop_file();
	schedule_poll(hci_poll_interval_us);

	return 0;
}

/* Returns 1 if data available, 0 if not */
int hci_virt_poll(void)
{
	if (client_fd < 0) {
		/* Waiting for reconnect; non-blocking try each call */
		try_accept();
		return 0;
	}

	struct pollfd pfd = { .fd = client_fd, .events = POLLIN };
	int rc = poll(&pfd, 1, 0);

	if (rc < 0) {
		return 0;
	}
	if (pfd.revents & (POLLHUP | POLLERR)) {
		nsi_print_trace("hci_socket: client disconnected (POLLHUP/POLLERR)\n");
		close(client_fd);
		client_fd = -1;
		return 0;
	}

	return (rc == 1) ? 1 : 0;
}

/* Non-blocking read: returns bytes read, 0 if no data, -1 on error */
long hci_virt_read(void *buf, unsigned long len)
{
	long n = read(client_fd, buf, len);

	if (n == 0) {
		nsi_print_trace("hci_socket: client disconnected (EOF)\n");
		close(client_fd);
		client_fd = -1;
		return 0;
	}

	if (n < 0) {
		if (errno == EAGAIN || errno == EWOULDBLOCK || errno == EINTR) {
			return 0;
		}

		return -1;
	}

	return n;
}

long hci_virt_write(const void *buf, unsigned long len)
{
	unsigned long total = 0;
	const uint8_t *p = buf;

	while (total < len) {
		long n = write(client_fd, p + total, len - total);

		if (n < 0) {
			if (errno == EINTR) {
				continue;
			}

			nsi_print_trace("hci_socket: write error (%s), client disconnected\n", strerror(errno));
			close(client_fd);
			client_fd = -1;
			return -1;
		}

		total += n;
	}

	return total;
}

void hci_virt_btsnoop_capture(const void *buf, unsigned long len, bool tx)
{
	uint8_t record[BTSNOOP_RECORD_HEADER_LEN + BTSNOOP_MAX_FRAME];
	const uint8_t *payload = buf;
	uint64_t timestamp_us;
	uint32_t drops;

	if (btsnoop_fd < 0) {
		return;
	}

	if (len > BTSNOOP_MAX_FRAME) {
		btsnoop_drops++;
		return;
	}

	timestamp_us = nsi_hws_get_time() + BTSNOOP_EPOCH_DELTA_US;
	drops = btsnoop_drops;

	put_be32(&record[0], (uint32_t)len);
	put_be32(&record[4], (uint32_t)len);
	put_be32(&record[8], tx ? 0U : 1U);
	put_be32(&record[12], drops);
	put_be64(&record[16], timestamp_us);
	memcpy(&record[BTSNOOP_RECORD_HEADER_LEN], payload, len);

	write_btsnoop_all(record, BTSNOOP_RECORD_HEADER_LEN + len);

	btsnoop_drops = 0;
}
```
